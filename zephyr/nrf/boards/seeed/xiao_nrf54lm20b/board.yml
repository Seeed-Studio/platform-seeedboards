## zephyr/nrf/boards/seeed/xiao_nrf54lm20b/board.yml
```yaml
board:
  name: xiao_nrf54lm20b
  full_name: XIAO nRF54LM20B
  vendor: seeed
  socs:
  - name: nrf54lm20b
    variants:
    - name: xip
      cpucluster: cpuflpr
runners:
  run_once:
    '--recover':
    - runners:
      - nrfjprog
      - nrfutil
      run: first
      groups:
      - boards:
        - xiao_nrf54lm20b/nrf54lm20b/cpuapp
        - xiao_nrf54lm20b/nrf54lm20b/cpuflpr
        - xiao_nrf54lm20b/nrf54lm20b/cpuflpr/xip
    '--erase':
    - runners:
      - nrfjprog
      - jlink
      - nrfutil
      run: first
      groups:
      - boards:
        - xiao_nrf54lm20b/nrf54lm20b/cpuapp
        - xiao_nrf54lm20b/nrf54lm20b/cpuflpr
        - xiao_nrf54lm20b/nrf54lm20b/cpuflpr/xip
    '--reset':
    - runners:
      - nrfjprog
      - jlink
      - nrfutil
      run: last
      groups:
      - boards:
        - xiao_nrf54lm20b/nrf54lm20b/cpuapp
        - xiao_nrf54lm20b/nrf54lm20b/cpuflpr
        - xiao_nrf54lm20b/nrf54lm20b/cpuflpr/xip
```
