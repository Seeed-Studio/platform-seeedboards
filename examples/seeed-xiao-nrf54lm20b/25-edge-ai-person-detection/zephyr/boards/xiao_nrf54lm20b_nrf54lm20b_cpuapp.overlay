/* XIAO nRF54LM20B Edge AI — offline person detection.
 *
 * Offline images are inferred by the Axon NPU; no camera or SPI device is needed.
 * Console stays on the board-default USB CDC ACM (cdc_acm_uart); we do NOT
 * redirect it to UART21 and do NOT disable the USB stack, so the platform's
 * 1200-bps DFU trigger keeps working. Only the Axon NPU node is enabled. */

&axon {
	status = "okay";
};
