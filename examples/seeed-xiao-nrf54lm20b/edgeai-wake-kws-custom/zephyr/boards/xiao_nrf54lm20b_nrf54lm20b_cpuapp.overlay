/* XIAO nRF54LM20B Edge AI — wakeword/KWS (LOCAL, no Bluetooth).
 *
 * Console stays on the board-default USB CDC ACM (cdc_acm_uart); we do NOT
 * redirect to UART21, so the 1200-bps DFU trigger keeps working. The microphone
 * power path (power_en + dmic_vdd LDO1), the PMIC (npm1300 over pmic_i2c) and
 * the PDM pinctrl are all board-defined and already enabled — only the Axon NPU
 * node and the dmic_dev alias (expected by the sample's DMIC source) are set
 * here. */

/* Keep the label expected by the SDK DMIC source; use board-default PDM pins. */
dmic_dev: &pdm20 {
	status = "okay";
};

&axon {
	status = "okay";
};
