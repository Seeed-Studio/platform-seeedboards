/*
 * Tap Wake overlay for XIAO nRF54L15.
 *
 * Enables IMU as wakeup source and disables boot-on for regulators
 * to allow proper deep sleep / wake behavior.
 */

&lsm6ds3tr_c {
	wakeup-source;
};

&rfsw_pwr {
	/delete-property/ regulator-boot-on;
};

&vbat_pwr {
	/delete-property/ regulator-boot-on;
};
