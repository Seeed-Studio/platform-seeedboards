## examples/zephyr-edge-impulse/zephyr/Kconfig
```kconfig
source "Kconfig.zephyr"

menu "Edge Impulse nRF54L15DK example"

config EI_INFERENCE_THREAD_STACK
    int "Inference thread stack size"
    default 256
    help
      "Set the Edge Impulse inference thread stack size."

config EI_INFERENCE_THREAD_PRIO
    int "Inference thread priority"
    default 5
    help
      "Set the Edge Impulse inference thread priority. The lower number, the higher prority."

config EI_USE_EXTERNAL_FLASH
    bool "Use external flash for EI storage"
    default y
    help
      Enable use of external flash (e.g., for DK board). Disable for boards without external flash like XIAO.

source "subsys/logging/Kconfig.template.log_config"

endmenu
```

## examples/zephyr-edge-impulse/zephyr/boards/nrf54l15dk_nrf54l15_cpuapp.conf
```kconfig
# DK-specific: External Flash memory
CONFIG_SPI=y
CONFIG_FLASH=y
CONFIG_SPI_NOR=y
CONFIG_SPI_NOR_SFDP_DEVICETREE=y
CONFIG_SPI_NOR_FLASH_LAYOUT_PAGE_SIZE=4096
CONFIG_NORDIC_QSPI_NOR=n

CONFIG_EI_USE_EXTERNAL_FLASH=y
```

## examples/zephyr-edge-impulse/zephyr/boards/xiao_nrf54l15_nrf54l15_cpuapp.conf
```kconfig
# XIAO-specific: Disable external Flash, use internal
CONFIG_SPI=y
CONFIG_FLASH=y

CONFIG_EI_USE_EXTERNAL_FLASH=n
```

## examples/zephyr-epaper/5inch83/zephyr/boards/xiao_nrf54lm20a_nrf54lm20a_cpuapp.conf
```kconfig
CONFIG_NEWLIB_LIBC=y
CONFIG_LV_USE_CLIB_MALLOC=y
CONFIG_LV_USE_CLIB_STRING=y
CONFIG_LV_USE_CLIB_SPRINTF=y
```

## examples/zephyr-rfsw/zephyr/Kconfig
```kconfig
source "Kconfig.zephyr"

mainmenu "Application Configuration"

menu "Antenna Configuration"

config DEFAULT_ANTENNA_EXTERNAL
    bool "Default to external antenna"
    default n
    help
      If set, the default antenna will be the external one.
      Otherwise, it will be the ceramic one.

endmenu
```

## zephyr/boards/arm/xiao_nrf54l15/Kconfig.xiao_nrf54l15
```kconfig
# Copyright (c) 2025 Seeed Technology Co., Ltd.
# SPDX-License-Identifier: Apache-2.0
config BOARD_XIAO_NRF54L15
	select SOC_NRF54L15_CPUAPP if BOARD_XIAO_NRF54L15_NRF54L15_CPUAPP ||  BOARD_XIAO_NRF54L15_NRF54L15_CPUAPP_SENSE
	select SOC_NRF54L15_CPUFLPR if \
		BOARD_XIAO_NRF54L15_NRF54L15_CPUFLPR || \
		BOARD_XIAO_NRF54L15_NRF54L15_CPUFLPR_XIP
```

## zephyr/boards/arm/xiao_nrf54l15/board.yml
```yaml
board:
  name: xiao_nrf54l15
  full_name: XIAO NRF54L15 (Sense)
  vendor: seeed
  socs:
  - name: nrf54l15
    variants:
    - name: 'sense'
      cpucluster: cpuapp
    - name: xip
      cpucluster: cpuflpr
```

## zephyr/boards/arm/xiao_nrf54lm20/Kconfig.defconfig
```kconfig
# Copyright (c) 2025 Seeed Technology Co., Ltd.
# SPDX-License-Identifier: Apache-2.0

if BOARD_XIAO_NRF54LM20A_NRF54LM20A_CPUAPP

config ROM_START_OFFSET
	default 0 if PARTITION_MANAGER_ENABLED
	default 0x800 if BOOTLOADER_MCUBOOT

endif # BOARD_XIAO_NRF54LM20A_NRF54LM20A_CPUAPP
```

## zephyr/boards/arm/xiao_nrf54lm20b/board.yml
```yaml
board:
  name: xiao_nrf54lm20b
  full_name: XIAO nRF54LM20B
  vendor: seeed
  socs:
  - name: nrf54lm20a
    variants:
    - name: xip
      cpucluster: cpuflpr
runners:
  run_once:
    '--recover':
    - runners:
      - nrfjprog
      - nrfutil
      run: first
      groups:
      - boards:
        - xiao_nrf54lm20b/nrf54lm20a/cpuapp
        - xiao_nrf54lm20b/nrf54lm20a/cpuflpr
        - xiao_nrf54lm20b/nrf54lm20a/cpuflpr/xip
    '--erase':
    - runners:
      - nrfjprog
      - jlink
      - nrfutil
      run: first
      groups:
      - boards:
        - xiao_nrf54lm20b/nrf54lm20a/cpuapp
        - xiao_nrf54lm20b/nrf54lm20a/cpuflpr
        - xiao_nrf54lm20b/nrf54lm20a/cpuflpr/xip
    '--reset':
    - runners:
      - nrfjprog
      - jlink
      - nrfutil
      run: last
      groups:
      - boards:
        - xiao_nrf54lm20b/nrf54lm20a/cpuapp
        - xiao_nrf54lm20b/nrf54lm20a/cpuflpr
        - xiao_nrf54lm20b/nrf54lm20a/cpuflpr/xip
```

## zephyr/boards/arm/xiao_nrf54lm20b/xiao_nrf54lm20b_nrf54lm20a_cpuapp_defconfig
```kconfig
# Copyright (c) 2025 Seeed Technology Co., Ltd.
# SPDX-License-Identifier: Apache-2.0

# Enable UART driver
CONFIG_SERIAL=y

# Enable console
CONFIG_CONSOLE=y
CONFIG_UART_CONSOLE=y

# Enable GPIO
CONFIG_GPIO=y

# Enable MPU
CONFIG_ARM_MPU=y

# Enable hardware stack protection
CONFIG_HW_STACK_PROTECTION=y

# MPU-based null-pointer dereferencing detection cannot
# be applied as the (0x0 - 0x400) is unmapped for this target.
CONFIG_NULL_POINTER_EXCEPTION_DETECTION_NONE=y

# Enable Cache
CONFIG_CACHE_MANAGEMENT=y
CONFIG_EXTERNAL_CACHE=y

# Start SYSCOUNTER on driver init
CONFIG_NRF_GRTC_START_SYSCOUNTER=y

# Enable MCUboot as default bootloader (for USB CDC ACM serial recovery)
CONFIG_BOOTLOADER_MCUBOOT=y

# ── SMP Server for DFU auto-reset ──
# Enables an SMP server in the application so that PlatformIO can send a
# mcumgr "reset" command over USB CDC ACM.  The application's OS mgmt
# handler writes the bootloader boot-mode flag via Zephyr's retention
# subsystem before rebooting, causing MCUboot to enter serial recovery.
CONFIG_MCUMGR_SMP_SERIAL=y
CONFIG_MCUMGR_CMD_OS_MGMT=y

# ── Boot mode retention ──
# Required by both the application (to set the flag) and MCUboot (to read
# the flag).  The DTS node "boot_mode_retention" provides the backing store.
CONFIG_RETENTION=y
CONFIG_RETAINED_MEM=y
CONFIG_RETENTION_BOOT_MODE=y
```

## zephyr/nrf/boards/seeed/xiao_nrf54lm20a/board.yml
```yaml
board:
  name: xiao_nrf54lm20a
  full_name: XIAO nRF54LM20A
  vendor: seeed
  socs:
  - name: nrf54lm20a
    variants:
    - name: xip
      cpucluster: cpuflpr
runners:
  run_once:
    '--recover':
    - runners:
      - nrfjprog
      - nrfutil
      run: first
      groups:
      - boards:
        - xiao_nrf54lm20a/nrf54lm20a/cpuapp
        - xiao_nrf54lm20a/nrf54lm20a/cpuflpr
        - xiao_nrf54lm20a/nrf54lm20a/cpuflpr/xip
    '--erase':
    - runners:
      - nrfjprog
      - jlink
      - nrfutil
      run: first
      groups:
      - boards:
        - xiao_nrf54lm20a/nrf54lm20a/cpuapp
        - xiao_nrf54lm20a/nrf54lm20a/cpuflpr
        - xiao_nrf54lm20a/nrf54lm20a/cpuflpr/xip
    '--reset':
    - runners:
      - nrfjprog
      - jlink
      - nrfutil
      run: last
      groups:
      - boards:
        - xiao_nrf54lm20a/nrf54lm20a/cpuapp
        - xiao_nrf54lm20a/nrf54lm20a/cpuflpr
        - xiao_nrf54lm20a/nrf54lm20a/cpuflpr/xip
```

## zephyr/nrf/boards/seeed/xiao_nrf54lm20a/xiao_nrf54lm20a_nrf54lm20a_cpuflpr_defconfig
```kconfig
# Copyright (c) 2025 Seeed Technology Co., Ltd.
# SPDX-License-Identifier: Apache-2.0

# Enable GPIO
CONFIG_GPIO=y

CONFIG_USE_DT_CODE_PARTITION=y

# Execute from SRAM
CONFIG_XIP=n

CONFIG_RISCV_ALWAYS_SWITCH_THROUGH_ECALL=y
```
