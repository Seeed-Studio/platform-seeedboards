## examples/seeed-xiao-nrf54lm20b/23-edge-ai-wake-words-local/zephyr/Kconfig
```kconfig
# SPDX-License-Identifier: LicenseRef-Nordic-5-Clause

menu "Wakeword and Keyword Spotting application"

choice APP_MODE
	prompt "Application mode"
	default APP_MODE_WW_GATED_KWS

config APP_MODE_WW_GATED_KWS
	bool "Wakeword-gated keyword spotting mode"
	help
	  Run keyword spotting model only after wakeword was detected. After configurable duration
	  without any keyword spotted switch back to wakeword detection.

config APP_MODE_WW_ONLY
	bool "Wakeword detection only mode"
	help
	  Run wakeword detection continuously without switching to keyword spotting.

config APP_MODE_KWS_ONLY
	bool "Keyword spotting only mode"
	help
	  Run keyword spotting continuously without the need to detect wakeword first.

endchoice

config WW_PROBABILITY_THRESHOLD
	int "Wakeword probability threshold"
	range 0 1000
	default 990

config WW_HISTORY_SIZE
	int "Size of wakeword predictions history"
	range 1 32
	default 20

config WW_COUNT_THRESHOLD
	int "Threshold for wakeword detection from predictions history"
	range 1 WW_HISTORY_SIZE
	default 15

config KWS_PERIOD_MS
	int "Length of keyword spotting window in wakeword-gated mode"
	default 3000

config KWS_EMA_ALPHA
	int "Exponential moving average coefficient for class probability"
	range 0 1000
	default 120

endmenu

source "Kconfig.zephyr"
```

## examples/seeed-xiao-nrf54lm20b/24-edge-ai-classification/zephyr/Kconfig
```kconfig
# SPDX-License-Identifier: LicenseRef-Nordic-5-Clause

menu "XIAO Edge AI classification"

config NRF_EDGEAI_CLASSIFICATION_MODEL_AXON
	bool "Use the Axon NPU model"
	default y
	depends on SOC_NRF54LM20B
	select NRF_AXON
	help
	  Use the NPU model from Nordic's official classification sample.

endmenu

source "Kconfig.zephyr"
```

## examples/seeed-xiao-nrf54lm20b/25-edge-ai-person-detection/zephyr/Kconfig
```kconfig
# SPDX-License-Identifier: LicenseRef-Nordic-5-Clause

menu "XIAO offline person detection"

config SCORE_THRESHOLD
	int "Model score threshold, in per mille"
	range 0 1000
	default 250
	help
	  Confidence threshold used to retain person detections.

config IOU_THRESHOLD
	int "Boxes IoU threshold, in per mille"
	range 0 1000
	default 450
	help
	  Non-maximum suppression overlap threshold.

endmenu

source "Kconfig.zephyr"
```

## examples/seeed-xiao-nrf54lm20b/26-edge-ai-hello-ei/zephyr/Kconfig
```kconfig
# SPDX-License-Identifier: LicenseRef-Nordic-5-Clause

menu "XIAO Hello Edge Impulse"

config HELLO_EI_DATA_BUF_SIZE
	int "Input-data buffer size in float values"
	default 512

endmenu

source "Kconfig.zephyr"
```

## examples/seeed-xiao-nrf54lm20b/edgeai-data-forwarder/zephyr/Kconfig
```kconfig
# SPDX-License-Identifier: LicenseRef-Nordic-5-Clause

menu "XIAO nRF54LM20B Edge AI Data Forwarder"

config DATA_FWD_PROTO
	bool "Data Forwarder protocol"
	default y
	select ENTROPY_GENERATOR if ENTROPY_NODE_ENABLED

if DATA_FWD_PROTO

config DATA_FWD_PROTO_ASCII_MODE
	bool "ASCII compatibility mode"
	default n


config DATA_FWD_PROTO_RING_BUF_SIZE
	int "Protocol ring buffer size (bytes)"
	default 4096

config DATA_FWD_PROTO_CRC
	bool "Append CRC-16 to each frame"
	default y
	depends on CRC

config DATA_FWD_PROTO_META_RESEND_S
	int "Session metadata resend period (seconds)"
	default 5
	range 1 600

config DATA_FWD_PROTO_MAX_CHANNELS
	int "Maximum channel count"
	default 6
	range 1 255

config DATA_FWD_PROTO_INT32_VALUES
	bool "Use 32-bit integer channel values"
	default y

config DATA_FWD_TRANSPORT_UART
	bool "USB CDC ACM UART transport"
	default y
	depends on SERIAL

config DATA_FWD_SENSOR_LSM6DSL
	bool "LSM6DS3TR-C (LSM6DSL-compatible) 6-axis IMU"
	default y
	depends on SENSOR
	depends on LSM6DSL

endif

endmenu

source "Kconfig.zephyr"
```

## zephyr/boards/arm/xiao_nrf54lm20a/board.yml
```yaml
board:
  name: xiao_nrf54lm20a
  full_name: XIAO nRF54LM20A
  vendor: seeed
  revision:
    format: major.minor.patch
    default: "1.0.0"
    revisions:
      - name: "1.0.0"
      - name: "2.0.0"
  socs:
  - name: nrf54lm20a
    variants:
    - name: xip
      cpucluster: cpuflpr
runners:
  run_once:
    '--recover':
    - runners:
      - nrfjprog
      - nrfutil
      run: first
      groups:
      - boards:
        - xiao_nrf54lm20a/nrf54lm20a/cpuapp
        - xiao_nrf54lm20a/nrf54lm20a/cpuflpr
        - xiao_nrf54lm20a/nrf54lm20a/cpuflpr/xip
    '--erase':
    - runners:
      - nrfjprog
      - jlink
      - nrfutil
      run: first
      groups:
      - boards:
        - xiao_nrf54lm20a/nrf54lm20a/cpuapp
        - xiao_nrf54lm20a/nrf54lm20a/cpuflpr
        - xiao_nrf54lm20a/nrf54lm20a/cpuflpr/xip
    '--reset':
    - runners:
      - nrfjprog
      - jlink
      - nrfutil
      run: last
      groups:
      - boards:
        - xiao_nrf54lm20a/nrf54lm20a/cpuapp
        - xiao_nrf54lm20a/nrf54lm20a/cpuflpr
        - xiao_nrf54lm20a/nrf54lm20a/cpuflpr/xip
```

## zephyr/modules/uf2_dfu_reset/Kconfig
```kconfig
# SPDX-License-Identifier: Apache-2.0

config UF2_DFU_RESET
	bool "Enable TinyUF2 1200-bps bootloader auto-trigger"
	default y
	help
	  Brings up Zephyr's standard USB device stack (UDC) + CDC ACM class
	  automatically at boot via SYS_INIT(), so the host sees a virtual
	  serial port. When that port is opened at 1200 baud, the module writes
	  the TinyUF2 DBL_TAP_MAGIC to the top of SRAM and resets into the
	  bootloader — no manual RESET double-tap required.

	  The STM32C5 USB DRD FS peripheral is driven by the standard
	  udc_stm32.c driver; its STM32C5 HAL2 support (upstream Zephyr PR
	  #105957, post-4.4.0) is carried as an override registered in
	  zephyr/fixes.yml (udc-stm32-hal2). This module only registers the
	  line-coding callback and does not implement its own USB stack.
```

## zephyr/modules/xiao_dfu_reset/Kconfig
```kconfig
# SPDX-License-Identifier: Apache-2.0

config XIAO_DFU_RESET
	bool "XIAO nRF54LM20 1200-bps bootloader auto-trigger"
	default y if BOARD_XIAO_NRF54LM20B_NRF54LM20B_CPUAPP
	default y if BOARD_XIAO_NRF54LM20A_NRF54LM20A_CPUAPP && BOARD_REVISION_2_0_0
	select UART_LINE_CTRL
	select REBOOT
	select RETAINED_MEM
	select RETENTION
	select RETENTION_BOOT_MODE
	help
	  Monitors the XIAO nRF54LM20 USB CDC ACM port (nRF54LM20B and
	  nRF54LM20A V2). A 1200-bps line-coding request records the
	  boot-loader mode in retained GPREGRET memory and cold-reboots into
	  the MCUboot firmware loader.
```
